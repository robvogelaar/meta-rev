## conf/layer.conf
```bitbake
# We have a conf and classes directory, add to BBPATH 
BBPATH .= ":${LAYERDIR}"
# We have recipes-* directories, add to BBFILES
BBFILES += "${LAYERDIR}/recipes-*/*/*.bb"
BBFILE_COLLECTIONS += "rev" 
BBFILE_PATTERN_rev = "^${LAYERDIR}/" 
BBFILE_PRIORITY_rev = "5"
```
